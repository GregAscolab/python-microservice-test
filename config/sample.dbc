VERSION ""

NS_ :

BS_:

BU_:

BO_ 100 MotorInfo: 4 Vector__XXX
 SG_ Temperature : 0|16@1- (0.1, -40) [-40|120] "C" Vector__XXX
 SG_ RPM : 16|16@1+ (1, 0) [0|8000] "rpm" Vector__XXX
